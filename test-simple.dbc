VERSION ""

NS_ :

BS_:

BU_: ECU1 ECU2 ECU3

BO_ 100 TestMessage1: 8 ECU1
 SG_ TestSignal1 : 0|8@1+ (1,0) [0|255] "" ECU2,ECU3

BO_ 200 TestMessage2: 8 ECU2
 SG_ TestSignal2 : 0|8@1+ (1,0) [0|255] "" ECU1

BA_DEF_ BO_  "GenMsgSendType" ENUM  "Cyclic","Event","IfActive","CE","CA";
BA_DEF_DEF_  "GenMsgSendType" "Cyclic";
